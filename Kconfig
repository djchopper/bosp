## Kconfig
```kconfig
################################################################################
# Daemon Configuration
################################################################################

menu "Daemon Setup"

menu "Platform Loader"

  choice
    prompt "Layout Parser"

    config BBQUE_PIL_LOADER
      bool "Platform Loader"
      ---help---
      The new platform loader for BarbequeRTRM Platform Layout files, that enable also
      multi-systems environment.

    config BBQUE_PIL_LEGACY
      bool "Legacy BPL Parser"
      ---help---
      The old parser for BarbequeRTRM Platform Layout files (under pil directory)
  endchoice

 # depends on BBQUE_PIL_LOADER
  source "barbeque/plugins/ploader/Kconfig"
endmenu

menu "Simulated Mode"

config BBQUE_TEST_PLATFORM_DATA
  bool "Use Test Platform Data (TPD)"
  default y if TARGET_ANDROID
  default n
  ---help---
  Build the BarbequeRTRM with support for Test Platform Data.
  When compiled with this option turned on, all the target specific
  platform control facilities are disabled.

  This could be a convenient way to use the BarbequeRTRM for initial
  application development and integration, without worry about daemon
  setup or requiring to run the daemon as root.

endmenu # Simulated mode

################################################################################
# Linux Resource Management
################################################################################

menu "Linux Resource Management"

menu "Linux Control Groups"
depends on !BBQUE_TEST_PLATFORM_DATA

config BBQUE_LINUX_CG_SYSTEMD
  bool "Mount CGroups in systemd directory"
  default y
  depends on TARGET_LINUX
  depends on !BBQUE_TEST_PLATFORM_DATA
  ---help---
  Mount Control Groups into the /sys/fs/cgroup/cpu,cpuset,cpuacct,memory,net_cls
  directory.


config BBQUE_LINUX_CG_MEMORY
  bool "Memory controller"
  default n
  depends on TARGET_LINUX
  depends on !BBQUE_TEST_PLATFORM_DATA
#  depends on !TARGET_ODROID_XU
  ---help---
  Enable the Control Groups memory controller for enforcing the memory
  assignment control.

config BBQUE_LINUX_CG_NET_BANDWIDTH
  bool "Network bandwidth controller"
  default n
  depends on TARGET_LINUX
  depends on !BBQUE_TEST_PLATFORM_DATA
  ---help---
  Enable the Control Groups net_cls controller for enforcing the network
  bandwidth assignment control.


config BBQUE_CGROUPS_DISTRIBUTED_ACTUATION
  bool "CGroups handled at RTLIb level"
  default n
  depends on TARGET_LINUX
  depends on !BBQUE_TEST_PLATFORM_DATA
  ---help---
  Control Groups are written by the RTLib rather than the Platform Proxy.
  Indeed, what is written into the CGroups is nonetheless decided by Barbeque.

endmenu # Linux Control Groups


config BBQUE_LINUX_PROC_MANAGER
  bool "Linux Process Management"
  depends on TARGET_LINUX || TARGET_ANDROID
  default n
  ---help---
  Enables BarbequeRTRM to monitor the status of other processes running
  on the machine, and take actions (if the suitable policy has been selected)


choice
depends on !BBQUE_TEST_PLATFORM_DATA
depends on BBQUE_PIL_LEGACY
  prompt "Memory locality"
  default BBQUE_MEMLOC_L3

  config BBQUE_MEMLOC_L3
    bool "L3 cache"

  config BBQUE_MEMLOC_L2
    bool "L2 cache"

  depends on !BBQUE_TEST_PLATFORM_DATA
  ---help---
  Select the memory locality that the BarbequeRTRM optimization policy should
  take into account to properly perform scheduling and resource allocation
  decisions.
  According to the option selected the resource manager can consider a CPU as
  an entity featuring one or more cores (processing elements), sharing a L3
  cache memory ("socket") or a L2 cache memory ("core").

endchoice # Memory locality

endmenu # Linux Resource Management

################################################################################

menu "Heterogeneous Systems"
depends on !BBQUE_TEST_PLATFORM_DATA

config BBQUE_OPENCL
  bool "OpenCL Run-time Management Support"
  depends on TARGET_LINUX
  depends on !BBQUE_TEST_PLATFORM_DATA
  select EXTERNAL_OPENCL
  default n
  ---help---
  Enable the support for run-time resource management of OpenCL applications.

config BBQUE_NVIDIA
  bool "NVIDIA Run-time Management Support"
  depends on TARGET_LINUX
  depends on !BBQUE_TEST_PLATFORM_DATA
  default n
  ---help---
  Enable the support for run-time resource management of NVIDIA resources.



endmenu # OpenCL Support


################################################################################

menu "Power Management"
depends on !BBQUE_TEST_PLATFORM_DATA
	source "barbeque/bbque/pm/Kconfig"

endmenu # Power Management

################################################################################

menu "Distributed Systems"
  depends on BBQUE_PIL_LOADER

  config BBQUE_DIST_MODE
    bool "Distributed Mode"
    default n
    ---help---
    If enabled, it configures the BarbequeRTRM to control a distributed multi-node
    system.

  choice
    prompt "Distributed Configuration"
    depends on BBQUE_DIST_MODE

    config BBQUE_DIST_HIERARCHICAL
      bool "Hierarchical"
      ---help---
      Master/slave configuration. A master instance of the BarbequeRTRM is responsible
      of driving the decisional process of the instances running on the other system
      nodes.

    config BBQUE_DIST_FULLY
      bool "Fully Distributed"
      ---help
      No master instance expected. Each instance make autonomous choices, eventually
      negotiating the workload distribution among the other peer instances running
      on the other system nodes.

  endchoice

  source "barbeque/plugins/agent_proxy/Kconfig"
  source "barbeque/mpi/Kconfig"

endmenu # Distributed Systems


endmenu # PIL Configuration

################################################################################
# Policies
################################################################################

menu "Policies"
  source "barbeque/plugins/schedpol/Kconfig"
endmenu


################################################################################
# RTLib
################################################################################

menu "Run-Time Library (RTLib)"
  source "barbeque/rtlib/Kconfig"
endmenu # RTLib Configuration


################################################################################
# Programming Model
################################################################################

menu "Programming Model"

config BBQUE_TG_PROG_MODEL
  bool "Task-graph based programming model"
  default y

menu "Task-Graph Library (libtg)"
  depends on BBQUE_TG_PROG_MODEL
  source "barbeque/libtg/Kconfig"
endmenu # libtg

endmenu # Programming model


################################################################################
# Advanced Options
################################################################################

menu "Advanced Options"

config BBQUE_BUILD_DEBUG
  bool "Build DEBUG version"
  default n
  ---help---
  Build the BarbequeRTRM with DEBUGGING support enabled.

  This will produce a version of both the daemon and the RTLib with much more
  logging messages and debug symbols, which is suitable for debugging purposes.

menu "Recipe Loader"
  source "barbeque/plugins/rloader/Kconfig"
endmenu

config BBQUE_APP_PRIO_LEVELS
  int "Number of Priority Levels"
  default 5
  ---help---
  Applications are scheduled according to their priority which is a value
  ranging from 0 (highest priority) to a defined minimum value.

  Recipies define the priority of the corresponding Application.

config BBQUE_RESOURCE_MAX_NUM
  int "Number of Resources per Type"
  default 32
  ---help---
  The maximum number of resources per resource type.

  For example, the maximum number of processing elements (computing cores)
  available per processor.

config BBQUE_RESOURCE_PATH_PREFIX
   string "Resource Path Prefix"
   default "sys"
   ---help---
  The prefix (in string format) of the resource paths under which perform the
  matching w.r.t. the resource requests in the application recipes.
  For instance, value="sys" means that we will look for requests of CPUs or
  ACCELERATORs starting from resource registered under "sys." (e.g. "sys.cpu"
  or "sys.acc").


config BBQUE_SCHED_PROFILING
  bool "Scheduling Profiling"
  default n
  ---help---
  Enable the scheduling profiling support

  This will collect statistics about the resource allocation metrics (e.g.,
  mean and variance of the AWM from the scheduled applications, fairness
  index, etc...)

config BBQUE_BUILD_TESTS
  bool "Build the TEST suite"
  default n
  ---help---
  Build the BarbequeRTRM test suite.

  This will build also the set of regression tests used to verify framework
  stability during development.
  NOTE: this is an experimental and not completed feaure, leave un-selected is
  unsure.

config BBQUE_EM
  bool "Event Manager"
  default n
  ---help---
  Build the BarbequeRTRM with support for Event Management (EM).

  The Event Manager is a component for tracing internal BarbequeRTRM events.
  The events archive can be then plotted by using the Event Viewer tool.

  If unsure say no, this will disable all the EM related features.

config BBQUE_DM
  bool "Data Manager"
  default n
  ---help---
  Build the BarbequeRTRM with support for Data Management (DM).

  The Data Manager is a component to provide a publish/subscribe support
  for client applications that need to retrieve information about the status
  of the system, application and allocation.

  If your system does not need to provide information to third party clients
  leave it disable to avoid dangerous information leakage.

  NOTE: this is an experimental and not completed feature, leave un-selected if
  unsure.

endmenu # Advanced options
```

## bbque/pm/Kconfig
```kconfig
config BBQUE_PM
  bool "Enable Power Management"
  default n
  ---help---
  Build the BarbequeRTRM with support for Power Management (PM).
  When compiled with this option turned on, all the PM management
  facilities could be selectively enabled or disabled. Indeed, each
  module could provide PM related supports, e.g. the optimization
  policy could optimize for power budgeting or the GPU could expose
  a power and thermal monitor.

  If unsure say no, this will disable all the PM related features.


config BBQUE_PM_NOACPI
  bool "NO ACPI Interface"
  depends on BBQUE_PM
  default n
   ---help---
  Avoid using the ACPI interfaces. Probably required since kernel 4.x versions.


config  BBQUE_PM_BATTERY
  bool "Battery Management"
  depends on BBQUE_PM
  default n
  ---help---
  Enable the interface with the system battery, if available.

config BBQUE_WM
  bool "Periodic Monitoring"
  depends on BBQUE_PM
  default n
  ---help---
  Enable the support for run-time monitoring of the system, providing data
  about thermal and power.

config  BBQUE_PM_CPU
  bool "CPU(s) Power Management"
  depends on BBQUE_PM
  default n
  ---help---
  Enable the support for the management of CPU(s) from the power-thermal point
  of view.


config  BBQUE_PM_NVIDIA
  bool "NVIDIA GPU(s) Power Management"
  depends on BBQUE_PM
  depends on !TARGET_LINUX_ARM
  default n
  ---help---
  Enable the support for the management of NVIDIA GPU(s) from the power-thermal
  point of view.

config  BBQUE_PM_AMD
  bool "AMD GPU(s) Power Management"
  depends on BBQUE_PM
  depends on BBQUE_OPENCL
  depends on !TARGET_LINUX_ARM
  default n
  ---help---
  Enable the support for the management of AMD GPU(s) from the power-thermal
  point of view.

config  BBQUE_PM_GPU_ARM_MALI
  bool "ARM Mali GPU Power Management"
  depends on BBQUE_PM
  depends on BBQUE_OPENCL
  depends on TARGET_LINUX_ARM
  default n
  ---help---
  Enable the support for the management of ARM Mali GPU(s) from the
  power-thermal point of view.

config  BBQUE_PM_MANGO
  bool "MANGO Platform Power Management"
  depends on BBQUE_PM
  depends on TARGET_LINUX_MANGO
  default n
  ---help---
  Enable the support for the management of a MANGO platform from the power
  management point of view.
```
